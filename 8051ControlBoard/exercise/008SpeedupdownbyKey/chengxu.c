
/********************************************************

实现功能：正转_反转_按下转松开停止
使用芯片：AT89S52
晶振：11.0592MHZ
编译环境：Keil
作者：zhangxinchunleo
网站：www.ourhc.cn
淘宝店：汇诚科技 http://shop36330473.taobao.com

【声明】此程序仅用于学习与参考，引用请注明版权和作者信息！     
********************************************************/
#include<reg52.h> //库文件
#define uchar unsigned char	//字符型宏定义
#define uint unsigned int	//整型宏定义
uchar tcnt;				    //定时器计数初值定义
uint sec;				    //速度值定义
/********************************************************
 						控制位定义
********************************************************/

sbit shi_neng=P1^0;  //	使能控制位
sbit fang_shi=P1^1;  //	工作方式控制位
sbit fang_xiang=P1^2;//	旋转方向控制位
sbit mai_chong=P1^3; // 脉冲控制位

sbit zheng_zhuan=P2^0;	//正转
sbit fang_zhuan=P2^1;	//反转


/********************************************************************
                            延时函数
*********************************************************************/
void delay(uchar t)
{
  uchar i,j;
   for(i=0;i<t;i++)
   {
   	 for(j=13;j>0;j--);
	 { ;
	 }
   }
}

/********************************************************************
                        定时中断服务函数
*********************************************************************/
void t0(void) interrupt 1 using 0 //定时中断服务函数
{
	tcnt++; //每过250ust tcnt 加一
	if(tcnt==1) //当tcnt满足条件时
	{
		tcnt=0; //计满重新再计
		sec++;
		if(sec==20) //括号内数值越小，电机转动速度越快
		{
			sec=0; //计满重新再计
			mai_chong=~mai_chong; //脉冲输出
		}
	}
}

/********************************************************
 						初始化
********************************************************/
void  init()
{
	TMOD=0x02; //定时器工作在方式2
	ET0=1;
	EA=1;
	TH0=0x06; //对TH0 TL0 赋值
	TL0=0x06;
	TR0=1; //开始定时
	sec=0;
	mai_chong=1; // 脉冲控制位
}

/********************************************************
 						主函数
********************************************************/

main()
{
    init();		 //程序初始化
	shi_neng=0;  //	使能控制位
	fang_shi=1;  //	工作方式控制 
	fang_xiang=1;// 控制方向为正转
	while(1)
	{
	 if(zheng_zhuan==0){delay(100);shi_neng=1;fang_xiang=0;while(!zheng_zhuan);delay(100);shi_neng=0;fang_xiang=0;}
	 if(fang_zhuan==0){delay(100);shi_neng=1;fang_xiang=1;while(!fang_zhuan);delay(100);shi_neng=0;fang_xiang=1;}
	}
}
/********************************************************
 						结束
********************************************************/