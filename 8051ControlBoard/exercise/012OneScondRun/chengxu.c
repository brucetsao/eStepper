
/********************************************************

实现功能：电机正转1秒，再反转1秒，依次循环
使用芯片：AT89S52
晶振：11.0592MHZ
编译环境：Keil
作者：zhangxinchunleo
网站：www.ourhc.cn
淘宝店：汇诚科技 http://shop36330473.taobao.com

【声明】此程序仅用于学习与参考，引用请注明版权和作者信息！     
********************************************************/
#include<reg52.h> //库文件
#define uchar unsigned char	//字符型宏定义
#define uint unsigned int	//整型宏定义

uint cnt=0;		  	 //设定转动脉冲数值
/********************************************************
 						控制位定义
********************************************************/

sbit shi_neng=P1^0;  //	使能控制位
sbit fang_shi=P1^1;  //	工作方式控制位
sbit fang_xiang=P1^2;//	旋转方向控制位
sbit mai_chong=P1^3; // 脉冲控制位

/********************************************************
 						脉冲延时函数
********************************************************/
void Mdelay(uint y)//延时函数
{
	uchar j,k;
	for(j=0;j<y;j++)
	for(k=0;k<250;k++);
}

/********************************************************
 						主函数
********************************************************/

main()
{
	shi_neng=0;  //	使能控制位
	fang_shi=1;  //	工作方式控制 
	fang_xiang=1;// 控制方向为正转
	mai_chong=1; // 脉冲控制位
	cnt=800;
	while(1)
	{
	     shi_neng=1;
		 fang_xiang=1;
		 cnt=1000;
				while(cnt--) 
				   {
					mai_chong=~mai_chong; //输出时钟脉冲
					Mdelay(3);
					}
			
		 shi_neng=1;
		 fang_xiang=0;
		 cnt=1000;
				while(cnt--) 
				   {
					mai_chong=~mai_chong; //输出时钟脉冲
					Mdelay(3);
					}
			} }

/********************************************************
 						结束
********************************************************/