
/********************************************************

实现功能：电机正转5转，停3秒，再反转7转，停止，依次循环
使用芯片：AT89S52
晶振：11.0592MHZ
编译环境：Keil
作者：zhangxinchunleo
网站：www.ourhc.cn
淘宝店：汇诚科技 http://shop36330473.taobao.com

【声明】此程序仅用于学习与参考，引用请注明版权和作者信息！     
********************************************************/
#include<reg52.h> //库文件
#define uchar unsigned char	//字符型宏定义
#define uint unsigned int	//整型宏定义

uint cnt=0;		  	 //设定转动脉冲数值
/********************************************************
 						控制位定义
********************************************************/

sbit shi_neng=P1^0;  //	使能控制位
sbit fang_shi=P1^1;  //	工作方式控制位
sbit fang_xiang=P1^2;//	旋转方向控制位
sbit mai_chong=P1^3; // 脉冲控制位

sbit qi_dong=P2^0;//启动按键
sbit ting_zhi=P2^1;//停止按键
/********************************************************************
                           时间延时函数
*********************************************************************/
void Tdelay(uchar i)//延时程序
{
uchar m,n,s;
for(m=i;m>0;m--)
for(n=20;n>0;n--)
for(s=248;s>0;s--);
}
/********************************************************
 						脉冲延时函数
********************************************************/
void Mdelay(uint y)//延时函数
{
	uchar j,k;
	for(j=0;j<y;j++)
	for(k=0;k<250;k++);
}

/********************************************************
 						主函数
********************************************************/

main()
{
	shi_neng=0;  //	使能控制位
	fang_shi=1;  //	工作方式控制 
	fang_xiang=1;// 控制方向为正转
	mai_chong=1; // 脉冲控制位
	cnt=800;
	while(1)
	{
  	 	if(qi_dong==0)
	 	 {
			Mdelay(3);
			while(!qi_dong)
			{
			while(1)
			{
		     shi_neng=1;
			 fang_xiang=1;
			 cnt=4000;
				while(cnt--) 
				   {
					mai_chong=~mai_chong; //输出时钟脉冲
					Mdelay(3);
					}
			
	 	  		    shi_neng=0;
					Tdelay(300);//毫秒
					shi_neng=1;
		 		    fang_xiang=0;
					cnt=5600;
					while(cnt--) 
					{
						mai_chong=~mai_chong; //输出时钟脉冲
						Mdelay(3);
					}
				   	shi_neng=0;
					Tdelay(20);//毫秒
			} }
	      }
     }
	
}
/********************************************************
 						结束
********************************************************/